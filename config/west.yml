## config/west.yml
```yaml
manifest:
  remotes:
    - name: zmkfirmware
      url-base: https://github.com/zmkfirmware
  projects:
    - name: zmk
      remote: zmkfirmware
      revision: main
      # import: config/west.yml
    - name: zephyr
      remote: zmkfirmware
      revision: main
      # path: modules/zephyr
  self:
    path: config
```
